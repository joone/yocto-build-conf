## conf/bblayers.conf
```bitbake
# POKY_BBLAYERS_CONF_VERSION is increased each time build/conf/bblayers.conf
# changes incompatibly
POKY_BBLAYERS_CONF_VERSION = "2"

BBPATH = "${TOPDIR}"
BBFILES ?= ""

BBLAYERS ?= " \
  /home/joone/otc/yocto/poky/meta \
  /home/joone/otc/yocto/poky/meta-poky \
  /home/joone/otc/yocto/poky/meta-yocto-bsp \
  /home/joone/otc/yocto/meta-crosswalk \
  /home/joone/otc/yocto/meta-nodejs \
  /home/joone/otc/yocto/meta-intel \
  /home/joone/otc/yocto/meta-openembedded/meta-oe \
  /home/joone/otc/yocto/meta-openembedded/meta-filesystems \
  "
```
